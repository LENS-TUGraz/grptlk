## CMakeLists.txt
```
# SPDX-License-Identifier: Apache-2.0

cmake_minimum_required(VERSION 3.20.0)
find_package(Zephyr REQUIRED HINTS $ENV{ZEPHYR_BASE})
project(iso_receive)

target_include_directories(app PRIVATE ${CMAKE_CURRENT_SOURCE_DIR}/../common/include)
target_sources(app PRIVATE src/main.c src/rx_stats.c)
```

## Kconfig
```
menuconfig GRPTLK
	bool "GRPTLK [EXPERIMENTAL]"
	select EXPERIMENTAL
	default n

if GRPTLK

config GRPTLK_MAX_ISO_CHAN_COUNT
	int "Max ISO channels"
	range 2 31
	default 5
	help
	  Maximum BIS channels the ISO receive sample allocates and syncs to.
	  BIS1 is downlink. One of BIS2..BISn may be used for uplink TX.
	  For nRF53 sysbuild builds, this value is driven by
	  SB_CONFIG_GRPTLK_MAX_ISO_CHAN_COUNT from Kconfig.sysbuild.

config GRPTLK_ISO_STATS_ENABLED
	bool "Enable ISO stats logging"
	default y
	help
	  Enable periodic ISO statistics logging for uplink and downlink traffic.

config GRPTLK_ISO_SDU_INTERVAL_US
	int "ISO SDU Interval (us)"
	default 10000
	help
	  The SDU interval in microseconds for the ISO stream interval.

config GRPTLK_UPLINK_BIS
	int "Uplink BIS index (static mode)"
	range 2 31
	default 2
	help
	  BIS index used for uplink TX in static mode (GRPTLK_UPLINK_MODE_STATIC).
	  BIS1 is reserved for downlink RX. Has no effect in random mode.

choice GRPTLK_UPLINK_MODE
	bool "Uplink BIS selection mode"
	depends on GRPTLK_RECV
	default GRPTLK_UPLINK_MODE_STATIC

config GRPTLK_UPLINK_MODE_STATIC
	bool "Static"
	help
	  Always transmit uplink on the fixed BIS index configured by
	  GRPTLK_UPLINK_BIS. Useful for deterministic testing.

config GRPTLK_UPLINK_MODE_RANDOM
	bool "Random"
	help
	  Randomly select one of the available uplink BISes (BIS2..BISn)
	  for each ISO send event using sys_rand32_get(). The selection
	  happens at each downlink SDU receive, spreading uplink load
	  across all available uplink channels.

endchoice # GRPTLK_UPLINK_MODE

choice GRPTLK_ROLE
    bool "GRPTLK Role"
    default GRPTLK_BCST

config GRPTLK_BCST
    bool "GRPTLK Broadcaster Role"

config GRPTLK_RECV
    bool "GRPTLK Receiver Role"

endchoice

config BT_ISO_MAX_CHAN
	default GRPTLK_MAX_ISO_CHAN_COUNT if GRPTLK_RECV

config BT_ISO_TX_BUF_COUNT
	default 8 if GRPTLK_RECV

config BT_ISO_RX_BUF_COUNT
	default 8 if GRPTLK_RECV

config BT_HCI_TX_STACK_SIZE
	default 1280 if GRPTLK_RECV

config BT_RX_STACK_SIZE
	default 4096 if GRPTLK_RECV

config BT_BUF_EVT_RX_COUNT
	default 16 if GRPTLK_RECV

# Single-core controller tuning follows the GRPTLK channel count.
config BT_CTLR_ADV_DATA_LEN_MAX
	default 191 if GRPTLK_RECV && BT_CTLR_ADV_EXT

config BT_CTLR_SCAN_DATA_LEN_MAX
	default 255 if GRPTLK_RECV && BT_CTLR_ADV_EXT

config BT_CTLR_ADV_ISO_PDU_LEN_MAX
	default 155 if GRPTLK_RECV && BT_CTLR_ADV_ISO

config BT_CTLR_SYNC_ISO_PDU_LEN_MAX
	default 155 if GRPTLK_RECV && BT_CTLR_SYNC_ISO && !BT_HCI_RAW

config BT_CTLR_ADV_ISO_STREAM_MAX
	default GRPTLK_MAX_ISO_CHAN_COUNT if GRPTLK_RECV && BT_CTLR_ADV_ISO

config BT_CTLR_ADV_ISO_STREAM_COUNT
	default GRPTLK_MAX_ISO_CHAN_COUNT if GRPTLK_RECV && BT_CTLR_ADV_ISO

config BT_CTLR_SYNC_ISO_STREAM_MAX
	default GRPTLK_MAX_ISO_CHAN_COUNT if GRPTLK_RECV && BT_CTLR_SYNC_ISO

config BT_CTLR_SYNC_ISO_STREAM_COUNT
	default GRPTLK_MAX_ISO_CHAN_COUNT if GRPTLK_RECV && BT_CTLR_SYNC_ISO

config BT_CTLR_ISOAL_SOURCES
	default GRPTLK_MAX_ISO_CHAN_COUNT if GRPTLK_RECV && (BT_CTLR_ADV_ISO || BT_CTLR_CONN_ISO)

config BT_CTLR_ISOAL_SINKS
	default GRPTLK_MAX_ISO_CHAN_COUNT if GRPTLK_RECV && (BT_CTLR_SYNC_ISO || BT_CTLR_CONN_ISO)

config BT_CTLR_ISO_TX_BUFFERS
	default BT_ISO_TX_BUF_COUNT if GRPTLK_RECV && (BT_CTLR_ADV_ISO || BT_CTLR_CONN_ISO)

config BT_CTLR_ISO_RX_BUFFERS
	default 8 if GRPTLK_RECV && (BT_CTLR_SYNC_ISO || BT_CTLR_CONN_ISO)

config BT_CTLR_ISO_TX_BUFFER_SIZE
	default 163 if GRPTLK_RECV && (BT_CTLR_ADV_ISO || BT_CTLR_CONN_ISO)

config BT_CTLR_ISO_TX_SDU_LEN_MAX
	default 155 if GRPTLK_RECV && (BT_CTLR_ADV_ISO || BT_CTLR_CONN_ISO)

endif # GRPTLK

source "Kconfig.zephyr"
```

## Kconfig.sysbuild
```
# Copyright 2023 Nordic Semiconductor ASA
# SPDX-License-Identifier: Apache-2.0

source "share/sysbuild/Kconfig"

config GRPTLK_MAX_ISO_CHAN_COUNT
	int "Max ISO channels (app + netcore)"
	range 2 31
	default 5
	help
	  Single sysbuild knob used to keep ISO channel limits aligned between
	  application core and hci_ipc netcore image.
	  Change this symbol for nRF53 builds to adjust max receivable streams.

config NET_CORE_BOARD
	string
	default "nrf5340dk/nrf5340/cpunet" if "$(BOARD)" = "nrf5340dk"
	default "nrf5340_audio_dk/nrf5340/cpunet" if "$(BOARD)" = "nrf5340_audio_dk"
	default "nrf5340bsim/nrf5340/cpunet" if $(BOARD_TARGET_STRING) = "NRF5340BSIM_NRF5340_CPUAPP"

config NET_CORE_IMAGE_HCI_IPC
	bool "HCI IPC image on network core"
	default y
	depends on NET_CORE_BOARD != ""
```

## prj.conf
```kconfig
# GRPTLK
CONFIG_GRPTLK=y
CONFIG_GRPTLK_RECV=y

# ISO payload sizes
# Runtime uplink payload length follows received downlink length.
# TX/RX MTU here define the compile-time host-side ceiling.
CONFIG_BT_ISO_TX_MTU=155
CONFIG_BT_ISO_RX_MTU=155

# Memory Settings
CONFIG_MAIN_STACK_SIZE=4096
CONFIG_SYSTEM_WORKQUEUE_STACK_SIZE=4096
CONFIG_BT_HCI_TX_STACK_SIZE=1280
CONFIG_BT_RX_STACK_SIZE=4096

# Bluetooth
CONFIG_BT=y
CONFIG_HWINFO=y
CONFIG_BT_OBSERVER=y
CONFIG_BT_BROADCASTER=y
CONFIG_BT_DEVICE_NAME="GRPTLK Receiver"

# Host features
CONFIG_BT_HCI=y
CONFIG_BT_HCI_VS=y

# ISO features
CONFIG_BT_ISO_BROADCASTER=y
CONFIG_BT_ISO_SYNC_RECEIVER=y
CONFIG_BT_ISO_TX_BUF_COUNT=8
CONFIG_BT_ISO_RX_BUF_COUNT=8

# Logging
CONFIG_LOG=y
CONFIG_BT_ISO_LOG_LEVEL_DBG=y
# CONFIG_LOG_MODE_IMMEDIATE=y
# CONFIG_LOG_BUFFER_SIZE=10000

# Set same the ACL RX buffer size as in hci_ipc on netcore so that
# HCI Controller to Host Flowcontrol is supported.
CONFIG_BT_BUF_ACL_RX_SIZE=255
CONFIG_BT_BUF_EVT_RX_COUNT=16

# Add Ozone debugger support
CONFIG_DEBUG_THREAD_INFO=y
CONFIG_HEAP_MEM_POOL_SIZE=4096

# CONFIG_BT_CONN_LOG_LEVEL_DBG=y
# CONFIG_BT_L2CAP_LOG_LEVEL_DBG=y
```

## netcore.conf
```kconfig
# Overlay on:
# zephyr/samples/bluetooth/hci_ipc/nrf5340_cpunet_iso_receive-bt_ll_sw_split.conf
#
# Goal for GroupTalk netcore:
# - support both GroupTalk roles (broadcaster + receiver)
# - keep only BIS broadcast/sync roles (no connected ISO roles)
# - free controller memory headroom for higher ISO stream counts

# Enable GRPTLK also in the netcore
CONFIG_GRPTLK=y

# Keep both BIS directions available for shared receiver/broadcaster use.
CONFIG_BT_BROADCASTER=y
CONFIG_BT_OBSERVER=y
CONFIG_BT_EXT_ADV=y
CONFIG_BT_PER_ADV=y
CONFIG_BT_PER_ADV_SYNC=y
CONFIG_BT_ISO_BROADCASTER=y
CONFIG_BT_ISO_SYNC_RECEIVER=y

# Only keep roles/features required by GroupTalk BIS traffic in both roles.
CONFIG_BT_CENTRAL=n
CONFIG_BT_PERIPHERAL=n
CONFIG_BT_ISO_CENTRAL=n
CONFIG_BT_ISO_PERIPHERAL=n
CONFIG_BT_CTLR_CENTRAL_ISO=n
CONFIG_BT_CTLR_PERIPHERAL_ISO=n
CONFIG_BT_PER_ADV_SYNC_TRANSFER_SENDER=n
CONFIG_BT_PER_ADV_SYNC_TRANSFER_RECEIVER=n
CONFIG_BT_CTLR_SYNC_TRANSFER_SENDER=n
CONFIG_BT_CTLR_SYNC_TRANSFER_RECEIVER=n
CONFIG_BT_CTLR_DTM_HCI=n
# PHY capability:
# - 1M PHY is mandatory in LE controller (always available)
# - keep both optional PHYs enabled for GroupTalk flexibility
CONFIG_BT_CTLR_PHY_2M=y
CONFIG_BT_CTLR_PHY_CODED=y
CONFIG_BT_CTLR_TX_PWR_DYNAMIC_CONTROL=n
CONFIG_BT_CTLR_ADVANCED_FEATURES=n
CONFIG_BT_PER_ADV_SYNC_MAX=1
CONFIG_BT_CTLR_ADV_SET=1
CONFIG_BT_CTLR_ADV_AUX_SET=1
CONFIG_BT_CTLR_ADV_SYNC_SET=1
CONFIG_BT_CTLR_SCAN_AUX_SET=1
CONFIG_BT_CTLR_ADV_DATA_BUF_MAX=2

# Advertisement and Scan Data Lengths
CONFIG_BT_CTLR_ADV_DATA_LEN_MAX=191
CONFIG_BT_CTLR_SCAN_DATA_LEN_MAX=255

# ISO Settings
CONFIG_BT_CTLR_ADV_ISO=y
CONFIG_BT_CTLR_ADV_ISO_INTERLEAVED=n
CONFIG_BT_CTLR_ADV_ISO_PDU_LEN_MAX=155

CONFIG_BT_CTLR_SYNC_ISO=y
CONFIG_BT_CTLR_SYNC_ISO_INTERLEAVED=n
# NOTE:
# With hci_ipc (BT_HCI_RAW), Zephyr constrains this to 251, so this cannot
# currently be reduced below 251 even if runtime payloads are smaller.
CONFIG_BT_CTLR_SYNC_ISO_PDU_LEN_MAX=251

# NOTE:
# Fallback stream/channel limits for shared netcore.conf use.
# In nRF53 iso_receive sysbuild builds, these values are overridden from
# SB_CONFIG_GRPTLK_MAX_ISO_CHAN_COUNT in samples/iso_receive/sysbuild.cmake.
CONFIG_BT_CTLR_ADV_ISO_STREAM_MAX=5
CONFIG_BT_CTLR_ADV_ISO_STREAM_COUNT=5
CONFIG_BT_CTLR_SYNC_ISO_STREAM_MAX=5
CONFIG_BT_CTLR_SYNC_ISO_STREAM_COUNT=5
CONFIG_BT_CTLR_ISOAL_SOURCES=5
CONFIG_BT_CTLR_ISOAL_SINKS=4
CONFIG_BT_ISO_MAX_CHAN=5

# 155-byte SDU + max 8-byte HCI ISO data header overhead
CONFIG_BT_CTLR_ISO_TX_BUFFER_SIZE=163
CONFIG_BT_CTLR_ISO_TX_SDU_LEN_MAX=155

# Keep default hci_ipc heap and tune ISO HCI raw buffer footprint.
CONFIG_HEAP_MEM_POOL_SIZE=4096
# Runtime uplink payload length follows received downlink length.
# TX/RX MTU here define the compile-time hci_ipc host-side ceiling.
CONFIG_BT_ISO_TX_MTU=155
CONFIG_BT_ISO_RX_MTU=155
CONFIG_BT_ISO_TX_BUF_COUNT=8
CONFIG_BT_ISO_RX_BUF_COUNT=8
CONFIG_BT_BUF_EVT_RX_COUNT=16

# Controller queueing tuned for continuous GroupTalk ISO traffic.
CONFIG_BT_CTLR_RX_BUFFERS=9
CONFIG_BT_CTLR_ISO_TX_BUFFERS=8
CONFIG_BT_CTLR_ISO_RX_BUFFERS=8
```

## boards/hwn001_nrf54l15_cpuapp.conf
```kconfig
# Single-core controller tuning is centralized in samples/iso_receive/Kconfig.
CONFIG_BT_CTLR_ADV_ISO=y
CONFIG_BT_CTLR_SYNC_ISO=y

# Enable Stuff for a FEM on nRF54LX
CONFIG_BT_CTLR_ADVANCED_FEATURES=y
CONFIG_BT_CTLR_RADIO_ENABLE_FAST=n
```

## boards/nrf52840dk_nrf52840.conf
```kconfig
# Single-core controller tuning is centralized in samples/iso_receive/Kconfig.
CONFIG_BT_CTLR_ADV_ISO=y
CONFIG_BT_CTLR_SYNC_ISO=y
```

## boards/nrf54l15dk_nrf54l15_cpuapp.conf
```kconfig
#  Advertisement and Scan Data Lengths
CONFIG_BT_CTLR_ADV_DATA_LEN_MAX=191
CONFIG_BT_CTLR_SCAN_DATA_LEN_MAX=1650

# ISO Settings
CONFIG_BT_CTLR_ADV_ISO=y
CONFIG_BT_CTLR_ADV_ISO_PDU_LEN_MAX=40
CONFIG_BT_CTLR_ADV_ISO_STREAM_MAX=31
CONFIG_BT_CTLR_ADV_ISO_STREAM_COUNT=31
CONFIG_BT_CTLR_ISOAL_SOURCES=31

CONFIG_BT_CTLR_SYNC_ISO=y
CONFIG_BT_CTLR_SYNC_ISO_PDU_LEN_MAX=247
CONFIG_BT_CTLR_SYNC_ISO_STREAM_MAX=31
CONFIG_BT_CTLR_SYNC_ISO_STREAM_COUNT=31

# ISOAL Settings
CONFIG_BT_CTLR_ISOAL_SOURCES=31
CONFIG_BT_CTLR_ISOAL_SINKS=31

# Support the highest SDU size required by this sample
CONFIG_BT_CTLR_ISO_TX_BUFFER_SIZE=14
CONFIG_BT_CTLR_ISO_TX_SDU_LEN_MAX=100
```

## src/main.c
```c
#include <zephyr/bluetooth/bluetooth.h>
#include <zephyr/bluetooth/conn.h>
#include <zephyr/bluetooth/hci_types.h>
#include <zephyr/bluetooth/iso.h>

#include "rx_stats.h"
#include <grptlk_uplink_stats.h>
#include <string.h>
#include <zephyr/kernel.h>
#include <zephyr/logging/log.h>
#include <zephyr/random/random.h>
#include <zephyr/sys/byteorder.h>
#include <zephyr/sys/util.h>
/* -------------------------------------------------------------------------------
 */
/* THIS IS THE BIS ON WHICH THE GRPTLK RECEIVER TRANSMITS BACK TO THE
 * BROADCASTER  */
/* E.g., in a BIG with 5 BISes, this parameter can be [2..5] (BIS1 is
 * downlink/rx) */
#define UPLINK_BIS CONFIG_GRPTLK_UPLINK_BIS
/* -------------------------------------------------------------------------------
 */

#define TIMEOUT_SYNC_CREATE K_SECONDS(10)

#define BT_LE_SCAN_CUSTOM                                                      \
  BT_LE_SCAN_PARAM(BT_LE_SCAN_TYPE_ACTIVE, BT_LE_SCAN_OPT_NONE,                \
                   BT_GAP_SCAN_FAST_INTERVAL, BT_GAP_SCAN_FAST_WINDOW)

#define PA_RETRY_COUNT 6

#define BIS_ISO_CHAN_COUNT CONFIG_GRPTLK_MAX_ISO_CHAN_COUNT
#define ISO_STATS_ENABLED CONFIG_GRPTLK_ISO_STATS_ENABLED

#define NUM_PRIME_PACKETS 2

LOG_MODULE_REGISTER(grptlk_iso_receive);

#if defined(CONFIG_GRPTLK_UPLINK_MODE_STATIC)
#if (UPLINK_BIS <= 1)
#error "UPLINK_BIS must be in BIS2..BISn (BIS1 is downlink)"
#endif

#if (UPLINK_BIS > BIS_ISO_CHAN_COUNT)
#error "UPLINK_BIS must be <= CONFIG_GRPTLK_MAX_ISO_CHAN_COUNT"
#endif
#endif /* CONFIG_GRPTLK_UPLINK_MODE_STATIC */

#if (CONFIG_BT_ISO_TX_MTU < CONFIG_BT_ISO_RX_MTU)
#error "CONFIG_BT_ISO_TX_MTU must be >= CONFIG_BT_ISO_RX_MTU"
#endif

static bool per_adv_found;
static bool per_adv_lost;
static bt_addr_le_t per_addr;
static uint8_t per_sid;
static uint32_t per_interval_us;
static uint16_t iso_uplink_sdu_len = CONFIG_BT_ISO_TX_MTU;
/* Actual number of BISes in the discovered BIG, clamped to BIS_ISO_CHAN_COUNT
 */
static uint8_t big_actual_num_bis = BIS_ISO_CHAN_COUNT;
/* BIS index (1-based) actually used for uplink TX; updated by
 * iso_select_uplink_chan() */
static uint8_t active_uplink_bis = UPLINK_BIS;

static K_SEM_DEFINE(sem_per_adv, 0, 1);
static K_SEM_DEFINE(sem_per_sync, 0, 1);
static K_SEM_DEFINE(sem_per_sync_lost, 0, 1);
static K_SEM_DEFINE(sem_per_big_info, 0, 1);
static K_SEM_DEFINE(sem_big_sync, 0, BIS_ISO_CHAN_COUNT);
static K_SEM_DEFINE(sem_big_sync_lost, 0, BIS_ISO_CHAN_COUNT);

static bool iso_datapaths_setup = false;

static void scan_recv(const struct bt_le_scan_recv_info *info,
                      struct net_buf_simple *buf) {
  ARG_UNUSED(buf);

  if (!per_adv_found && info->interval) {
    per_adv_found = true;

    per_sid = info->sid;
    per_interval_us = BT_CONN_INTERVAL_TO_US(info->interval);
    bt_addr_le_copy(&per_addr, info->addr);

    k_sem_give(&sem_per_adv);
  }
}

static struct bt_le_scan_cb scan_callbacks = {
    .recv = scan_recv,
};

static void sync_cb(struct bt_le_per_adv_sync *sync,
                    struct bt_le_per_adv_sync_synced_info *info) {
  ARG_UNUSED(sync);
  ARG_UNUSED(info);

  k_sem_give(&sem_per_sync);
}

static void term_cb(struct bt_le_per_adv_sync *sync,
                    const struct bt_le_per_adv_sync_term_info *info) {
  char le_addr[BT_ADDR_LE_STR_LEN];

  bt_addr_le_to_str(info->addr, le_addr, sizeof(le_addr));

  LOG_INF("PER_ADV_SYNC[%u]: [DEVICE]: %s sync terminated",
          bt_le_per_adv_sync_get_index(sync), le_addr);

  per_adv_lost = true;
  k_sem_give(&sem_per_sync_lost);
}

static void biginfo_cb(struct bt_le_per_adv_sync *sync,
                       const struct bt_iso_biginfo *biginfo) {
  ARG_UNUSED(sync);

  uint16_t preferred_len = biginfo->max_sdu;

  if (preferred_len == 0U) {
    preferred_len = biginfo->max_pdu;
  }
  if (preferred_len == 0U) {
    preferred_len = CONFIG_BT_ISO_TX_MTU;
  }
  if (preferred_len > CONFIG_BT_ISO_TX_MTU) {
    LOG_WRN("BIG info SDU %u exceeds TX MTU %u, clamping uplink size",
            preferred_len, CONFIG_BT_ISO_TX_MTU);
    preferred_len = CONFIG_BT_ISO_TX_MTU;
  }

  iso_uplink_sdu_len = preferred_len;

  /* Clamp to our configured capacity */
  big_actual_num_bis = MIN(biginfo->num_bis, (uint8_t)BIS_ISO_CHAN_COUNT);
  LOG_INF("BIG has %u BIS(es), syncing to %u (capacity %u)", biginfo->num_bis,
          big_actual_num_bis, (uint8_t)BIS_ISO_CHAN_COUNT);

  /* Record PHY for inclusion in uplink stats reports */
  rx_stats_set_phy(biginfo->phy);

  k_sem_give(&sem_per_big_info);
}

static struct bt_le_per_adv_sync_cb sync_callbacks = {
    .synced = sync_cb,
    .term = term_cb,
    .biginfo = biginfo_cb,
};

NET_BUF_POOL_FIXED_DEFINE(bis_tx_pool, BIS_ISO_CHAN_COUNT,
                          BT_ISO_SDU_BUF_SIZE(CONFIG_BT_ISO_TX_MTU),
                          CONFIG_BT_CONN_TX_USER_DATA_SIZE, NULL);

static uint16_t seq_num;
static uint8_t iso_data[CONFIG_BT_ISO_TX_MTU] = {0};

static struct bt_iso_chan *bis[BIS_ISO_CHAN_COUNT];

static int iso_chan_index(struct bt_iso_chan *chan) {
  for (int i = 0; i < BIS_ISO_CHAN_COUNT; i++) {
    if (chan == bis[i]) {
      return i;
    }
  }

  return -1;
}

static struct bt_iso_chan *iso_select_uplink_chan(void);

#define TX_THREAD_STACK_SIZE 1024
#define TX_THREAD_PRIORITY 5

static struct k_thread tx_thread_data;
K_THREAD_STACK_DEFINE(tx_thread_stack, TX_THREAD_STACK_SIZE);
static K_SEM_DEFINE(tx_sem, 0, 1);

static void tx_thread(void *arg1, void *arg2, void *arg3) {
  int err;
  struct net_buf *buf;
  struct bt_iso_chan *ul_chan;
  size_t uplink_len;

  while (true) {
    k_sem_take(&tx_sem, K_FOREVER);

    ul_chan = iso_select_uplink_chan();
    if (ul_chan == NULL) {
      continue;
    }

    uplink_len = iso_uplink_sdu_len;
    if ((uplink_len == 0U) || (uplink_len > sizeof(iso_data))) {
      rx_stats_tx_send_fail();
      continue;
    }

    buf = net_buf_alloc(&bis_tx_pool, K_NO_WAIT);
    if (!buf) {
      rx_stats_tx_alloc_fail();
      continue;
    }

    rx_stats_prepare_uplink_payload(iso_data, uplink_len, seq_num,
                                    active_uplink_bis);

    net_buf_reserve(buf, BT_ISO_CHAN_SEND_RESERVE);
    net_buf_add_mem(buf, iso_data, uplink_len);

    err = bt_iso_chan_send(ul_chan, buf, seq_num);
    if (err < 0) {
      rx_stats_tx_send_fail();
      net_buf_unref(buf);
      continue;
    }

    rx_stats_tx_ok();
    seq_num++;
  }
}

static void iso_sent(struct bt_iso_chan *chan) {
  if ((active_uplink_bis > 0U) && (active_uplink_bis <= big_actual_num_bis) &&
      (chan == bis[active_uplink_bis - 1U])) {
    k_sem_give(&tx_sem);
  }
}

static struct bt_iso_chan *iso_select_uplink_chan(void);

static void iso_recv(struct bt_iso_chan *chan,
                     const struct bt_iso_recv_info *info, struct net_buf *buf) {
  int chan_idx;

  chan_idx = iso_chan_index(chan);
  if (chan_idx < 0) {
    return;
  }
  if (chan_idx != 0) {
    return;
  }

  rx_stats_rx_downlink(info, buf);

  /* Accept any SDU length up to configured RX MTU */
  if (buf && buf->len > 0U && buf->len <= CONFIG_BT_ISO_RX_MTU) {
    /* Keep uplink payload size aligned with received BIS payload size */
    iso_uplink_sdu_len = (uint16_t)buf->len;
  }
}

static struct bt_iso_chan *iso_select_uplink_chan(void) {
#if defined(CONFIG_GRPTLK_UPLINK_MODE_RANDOM)
  /* Randomly pick from the available uplink BISes (BIS2..BISn). */
  uint8_t num_uplink =
      (big_actual_num_bis > 1U) ? (big_actual_num_bis - 1U) : 0U;

  if (num_uplink == 0U) {
    return NULL;
  }
  uint8_t idx = (uint8_t)(sys_rand32_get() % num_uplink);

  active_uplink_bis = idx + 2U;
  return bis[active_uplink_bis - 1U];
#else
  active_uplink_bis = UPLINK_BIS;
  return bis[UPLINK_BIS - 1];
#endif
}

static void iso_connected(struct bt_iso_chan *chan) {
  int chan_idx;

  LOG_INF("ISO Channel %p connected", chan);
  seq_num = 0U;
  rx_stats_reset_seq();

  /* Snapshot channel parameters for BIS1 (downlink) only */
  chan_idx = iso_chan_index(chan);
  if (chan_idx == 0) {
    rx_stats_update_chan_info(chan);
  }

  k_sem_give(&sem_big_sync);
}

static void iso_disconnected(struct bt_iso_chan *chan, uint8_t reason) {
  LOG_INF("ISO Channel %p disconnected with reason 0x%02x", chan, reason);

  if (reason != BT_HCI_ERR_OP_CANCELLED_BY_HOST) {
    iso_datapaths_setup = false;
    k_sem_give(&sem_big_sync_lost);
  }
}

static struct bt_iso_chan_ops iso_ops = {
    .recv = iso_recv,
    .sent = iso_sent,
    .connected = iso_connected,
    .disconnected = iso_disconnected,
};

static struct bt_iso_chan_io_qos iso_rx_qos;
static struct bt_iso_chan_io_qos iso_tx_qos = {
    .sdu = CONFIG_BT_ISO_TX_MTU,
    .rtn = 1,
    .phy = BT_GAP_LE_PHY_2M,
};

static struct bt_iso_chan_qos bis_iso_qos = {
    .tx = &iso_tx_qos,
    .rx = &iso_rx_qos,
};

static struct bt_iso_chan bis_iso_chan[BIS_ISO_CHAN_COUNT];

static struct bt_iso_big_sync_param big_sync_param = {
    .bis_channels = bis,
    /* num_bis and bis_bitfield are set at runtime from biginfo->num_bis */
    .num_bis = BIS_ISO_CHAN_COUNT,
    .bis_bitfield = (BIT_MASK(BIS_ISO_CHAN_COUNT)),
    .mse = BT_ISO_SYNC_MSE_ANY,
    .sync_timeout = 100, /* in 10 ms units */
};

static void iso_init_channels(void) {
  for (int i = 0; i < BIS_ISO_CHAN_COUNT; i++) {
    bis_iso_chan[i].ops = &iso_ops;
    bis_iso_chan[i].qos = &bis_iso_qos;
    bis[i] = &bis_iso_chan[i];
  }
}

static void reset_semaphores(void) {
  k_sem_reset(&sem_per_adv);
  k_sem_reset(&sem_per_sync);
  k_sem_reset(&sem_per_sync_lost);
  k_sem_reset(&sem_per_big_info);
  k_sem_reset(&sem_big_sync);
  k_sem_reset(&sem_big_sync_lost);
}

int main(void) {
  struct bt_le_per_adv_sync_param sync_create_param;
  struct bt_le_per_adv_sync *sync;
  struct bt_iso_big *big;
  uint32_t sem_timeout_us;
  int err;

  LOG_INF("Starting GRPTLK Receiver");
  iso_init_channels();

  /* Initialize the Bluetooth Subsystem */
  err = bt_enable(NULL);
  if (err) {
    LOG_ERR("Bluetooth init failed (err %d)", err);
    return 0;
  }

  rx_stats_init_device_id();
  rx_stats_init_report_cache(active_uplink_bis);

  k_thread_create(&tx_thread_data, tx_thread_stack,
                  K_THREAD_STACK_SIZEOF(tx_thread_stack), tx_thread, NULL, NULL,
                  NULL, TX_THREAD_PRIORITY, 0, K_NO_WAIT);

  LOG_INF("Scan callbacks register...");
  bt_le_scan_cb_register(&scan_callbacks);
  LOG_INF("success.");

  LOG_INF("Periodic Advertising callbacks register...");
  bt_le_per_adv_sync_cb_register(&sync_callbacks);
  LOG_INF("Success.");

  do {
    reset_semaphores();
    per_adv_lost = false;

    LOG_INF("Start scanning...");
    err = bt_le_scan_start(BT_LE_SCAN_CUSTOM, NULL);
    if (err) {
      LOG_ERR("failed (err %d)", err);
      return 0;
    }
    LOG_INF("success.");

    LOG_INF("Waiting for periodic advertising...");
    per_adv_found = false;
    err = k_sem_take(&sem_per_adv, K_FOREVER);
    if (err) {
      LOG_ERR("failed (err %d)", err);
      return 0;
    }
    LOG_INF("Found periodic advertising.");

    LOG_INF("Stop scanning...");
    err = bt_le_scan_stop();
    if (err) {
      LOG_ERR("failed (err %d)", err);
      return 0;
    }
    LOG_INF("success.");

    LOG_INF("Creating Periodic Advertising Sync...");
    bt_addr_le_copy(&sync_create_param.addr, &per_addr);
    sync_create_param.options = 0;
    sync_create_param.sid = per_sid;
    sync_create_param.skip = 0;
    /* Multiple PA interval with retry count and convert to unit of 10 ms */
    sync_create_param.timeout =
        (per_interval_us * PA_RETRY_COUNT) / (10 * USEC_PER_MSEC);
    sem_timeout_us = per_interval_us * PA_RETRY_COUNT;
    err = bt_le_per_adv_sync_create(&sync_create_param, &sync);
    if (err) {
      LOG_ERR("failed (err %d)", err);
      return 0;
    }
    LOG_INF("success.");

    LOG_INF("Waiting for periodic sync...");
    err = k_sem_take(&sem_per_sync, K_USEC(sem_timeout_us));
    if (err) {
      LOG_ERR("failed (err %d)", err);

      LOG_INF("Deleting Periodic Advertising Sync...");
      err = bt_le_per_adv_sync_delete(sync);
      if (err) {
        LOG_ERR("failed (err %d)", err);
        return 0;
      }
      continue;
    }
    LOG_INF("Periodic sync established.");

    LOG_INF("Waiting for BIG info...");
    err = k_sem_take(&sem_per_big_info, K_USEC(sem_timeout_us));
    if (err) {
      LOG_ERR("failed (err %d)", err);

      if (per_adv_lost) {
        continue;
      }

      LOG_INF("Deleting Periodic Advertising Sync...");
      err = bt_le_per_adv_sync_delete(sync);
      if (err) {
        LOG_ERR("failed (err %d)", err);
        return 0;
      }
      continue;
    }
    LOG_INF("Periodic sync established.");

    iso_tx_qos.sdu = iso_uplink_sdu_len;
    LOG_INF("Uplink SDU length configured to %u bytes.", iso_tx_qos.sdu);

  big_sync_create:
    /* Use the actual BIG size discovered via biginfo, clamped to our capacity
     */
    big_sync_param.num_bis = big_actual_num_bis;
    big_sync_param.bis_bitfield = BIT_MASK(big_actual_num_bis);
    LOG_INF("Create BIG Sync (num_bis=%u, bitfield=0x%x)...",
            big_sync_param.num_bis, big_sync_param.bis_bitfield);
    err = bt_iso_big_sync(sync, &big_sync_param, &big);
    if (err) {
      LOG_ERR("failed (err %d)", err);
      return 0;
    }
    LOG_INF("success.");

    for (uint8_t chan = 0U; chan < big_actual_num_bis; chan++) {
      LOG_INF("Waiting for BIG sync chan %u...", chan);
      err = k_sem_take(&sem_big_sync, TIMEOUT_SYNC_CREATE);
      if (err) {
        break;
      }
      LOG_INF("BIG sync chan %u successful.", chan);
    }
    if (err) {
      LOG_ERR("failed (err %d)", err);

      LOG_INF("BIG Sync Terminate...");
      err = bt_iso_big_terminate(big);
      if (err) {
        LOG_ERR("failed (err %d)", err);
        return 0;
      }
      LOG_INF("done.");

      goto per_sync_lost_check;
    }
    LOG_INF("BIG sync established.");

    for (uint8_t chan = 0U; chan < big_actual_num_bis; chan++) {
      LOG_INF("Setting data path chan %u...", chan);

      const struct bt_iso_chan_path hci_path = {
          .pid = BT_ISO_DATA_PATH_HCI,
          .format = BT_HCI_CODING_FORMAT_TRANSPARENT,
      };

      uint8_t dir = BT_HCI_DATAPATH_DIR_HOST_TO_CTLR;

      if (chan == 0) {
        dir = BT_HCI_DATAPATH_DIR_CTLR_TO_HOST;
      }

      err = bt_iso_setup_data_path(bis[chan], dir, &hci_path);
      if (err != 0) {
        LOG_ERR("Failed to setup ISO RX data path: %d", err);
      }

      LOG_INF("Setting data path complete chan %u.", chan);
    }

    iso_datapaths_setup = true;

    /* Give exactly 1 token to start the engine.
     * We only want ONE packet to be sent per interval. */
    k_sem_give(&tx_sem);

    for (uint8_t chan = 0U; chan < big_actual_num_bis; chan++) {
      LOG_INF("Waiting for BIG sync lost chan %u...", chan);
      err = k_sem_take(&sem_big_sync_lost, K_FOREVER);
      if (err) {
        LOG_ERR("failed (err %d)", err);
        return 0;
      }
      LOG_INF("BIG sync lost chan %u.", chan);
    }
    LOG_INF("BIG sync lost.");

  per_sync_lost_check:
    LOG_INF("Check for periodic sync lost...");
    err = k_sem_take(&sem_per_sync_lost, K_NO_WAIT);
    if (err) {
      /* Periodic Sync active, go back to creating BIG Sync */
      goto big_sync_create;
    }
    LOG_INF("Periodic sync lost.");
  } while (true);
}
```

## src/rx_stats.c
```c
#include "rx_stats.h"

#if IS_ENABLED(CONFIG_GRPTLK_ISO_STATS_ENABLED)

#include <zephyr/bluetooth/bluetooth.h>
#include <zephyr/bluetooth/iso.h>
#include <zephyr/kernel.h>
#include <zephyr/logging/log.h>
#include <zephyr/sys/byteorder.h>
#include <string.h>
#include <grptlk_uplink_stats.h>

#define BIS_ISO_CHAN_COUNT CONFIG_GRPTLK_MAX_ISO_CHAN_COUNT

LOG_MODULE_DECLARE(grptlk_iso_receive);

struct iso_tx_stats
{
	uint32_t ok;
	uint32_t alloc_fail;
	uint32_t send_fail;
};

struct iso_rx_stats
{
	uint32_t total;
	uint32_t valid_flag;
	uint32_t lost_flag;
	uint32_t error_flag;
	uint32_t bad_len;
	uint32_t seq_gap_events;
	uint32_t seq_gap_packets;
	uint32_t old_or_dup;
};

BUILD_ASSERT(sizeof(struct grptlk_uplink_stats_v1) == GRPTLK_UPLINK_STATS_V1_SIZE,
	     "Stats v1 payload format must stay 40 bytes");
BUILD_ASSERT(sizeof(struct grptlk_uplink_stats_v2) == GRPTLK_UPLINK_STATS_V2_SIZE,
	     "Stats v2 payload format must stay 40 bytes");

static struct iso_tx_stats iso_uplink_tx_stats;
static struct iso_rx_stats iso_downlink_rx_stats;
static uint16_t iso_recv_expected_seq[BIS_ISO_CHAN_COUNT];
static bool iso_recv_seq_initialized[BIS_ISO_CHAN_COUNT];

static uint8_t dl_phy;
static struct bt_iso_info dl_chan_info;
static bool dl_chan_info_valid;

static uint8_t grptlk_device_id[GRPTLK_DEVICE_ID_LEN];
static uint8_t grptlk_device_id_len;
static uint32_t report_last_ms;
static struct grptlk_uplink_stats_v2 report_cache;

void rx_stats_init_device_id(void)
{
	bt_addr_le_t addrs[CONFIG_BT_ID_MAX];
	size_t count = ARRAY_SIZE(addrs);

	bt_id_get(addrs, &count);
	if (count > 0U) {
		grptlk_device_id_len = sizeof(addrs[0].a.val);
		memcpy(grptlk_device_id, addrs[0].a.val, grptlk_device_id_len);
	} else {
		grptlk_device_id_len = 0U;
		memset(grptlk_device_id, 0, sizeof(grptlk_device_id));
	}
}

void rx_stats_init_report_cache(uint8_t active_uplink_bis)
{
	memset(&report_cache, 0, sizeof(report_cache));
	report_cache.magic[0] = GRPTLK_UPLINK_MAGIC_0;
	report_cache.magic[1] = GRPTLK_UPLINK_MAGIC_1;
	report_cache.version = GRPTLK_UPLINK_VERSION_2;
	report_cache.type = GRPTLK_UPLINK_TYPE_STATS_V2;
	report_cache.uplink_bis = active_uplink_bis;
	report_cache.dev_id_len = grptlk_device_id_len;
	memcpy(report_cache.dev_id, grptlk_device_id, sizeof(report_cache.dev_id));
	report_last_ms = k_uptime_get_32();
}

void rx_stats_set_phy(uint8_t phy)
{
	dl_phy = phy;
}

void rx_stats_update_chan_info(struct bt_iso_chan *chan)
{
	int err = bt_iso_chan_get_info(chan, &dl_chan_info);

	dl_chan_info_valid = (err == 0);
	if (err != 0) {
		LOG_WRN("bt_iso_chan_get_info failed: %d", err);
	}
}

static void refresh_report_cache(void)
{
	uint32_t now = k_uptime_get_32();
	uint32_t elapsed_ms = now - report_last_ms;

	report_cache.interval_ms = sys_cpu_to_le16((uint16_t)MIN(elapsed_ms, UINT16_MAX));
	report_cache.dl_rx_total = sys_cpu_to_le16((uint16_t)iso_downlink_rx_stats.total);
	report_cache.dl_rx_valid = sys_cpu_to_le16((uint16_t)iso_downlink_rx_stats.valid_flag);
	report_cache.dl_rx_lost = sys_cpu_to_le16((uint16_t)iso_downlink_rx_stats.lost_flag);
	report_cache.dl_rx_gap_packets = sys_cpu_to_le16((uint16_t)iso_downlink_rx_stats.seq_gap_packets);
	report_cache.dl_rx_gap_events = sys_cpu_to_le16((uint16_t)iso_downlink_rx_stats.seq_gap_events);
	report_cache.dl_rx_old_or_dup = sys_cpu_to_le16((uint16_t)iso_downlink_rx_stats.old_or_dup);
	report_cache.ul_tx_ok = sys_cpu_to_le16((uint16_t)iso_uplink_tx_stats.ok);
	report_cache.ul_tx_alloc_fail = sys_cpu_to_le16((uint16_t)iso_uplink_tx_stats.alloc_fail);
	report_cache.ul_tx_send_fail = sys_cpu_to_le16((uint16_t)iso_uplink_tx_stats.send_fail);

	report_cache.phy = dl_phy;
	if (dl_chan_info_valid) {
		report_cache.chan_info = GRPTLK_CHAN_INFO_PACK(dl_chan_info.sync_receiver.bn,
							      dl_chan_info.sync_receiver.irc);
		report_cache.chan_max_pdu = sys_cpu_to_le16(dl_chan_info.sync_receiver.max_pdu);
	}

	report_last_ms = now;
}

void rx_stats_reset_seq(void)
{
	memset(iso_recv_seq_initialized, 0, sizeof(iso_recv_seq_initialized));
}

void rx_stats_tx_ok(void)
{
	iso_uplink_tx_stats.ok++;
}

void rx_stats_tx_alloc_fail(void)
{
	iso_uplink_tx_stats.alloc_fail++;
}

void rx_stats_tx_send_fail(void)
{
	iso_uplink_tx_stats.send_fail++;
}

void rx_stats_rx_downlink(const struct bt_iso_recv_info *info, struct net_buf *buf)
{
	struct iso_rx_stats *rx_stats = &iso_downlink_rx_stats;
	int chan_idx = 0; /* Downlink is always index 0 */

	if (iso_recv_seq_initialized[chan_idx])
	{
		uint16_t delta =
			(uint16_t)(info->seq_num - iso_recv_expected_seq[chan_idx]);

		if ((delta > 0U) && (delta < 0x8000U))
		{
			rx_stats->seq_gap_events++;
			rx_stats->seq_gap_packets += delta;
		}
		else if (delta >= 0x8000U)
		{
			rx_stats->old_or_dup++;
		}
	}

	iso_recv_expected_seq[chan_idx] = (uint16_t)(info->seq_num + 1U);
	iso_recv_seq_initialized[chan_idx] = true;
	rx_stats->total++;

	if ((info->flags & BT_ISO_FLAGS_VALID) != 0U)
	{
		rx_stats->valid_flag++;
	}
	if ((info->flags & BT_ISO_FLAGS_LOST) != 0U)
	{
		rx_stats->lost_flag++;
	}
	if ((info->flags & BT_ISO_FLAGS_ERROR) != 0U)
	{
		rx_stats->error_flag++;
	}

	/* Accept any SDU length up to configured RX MTU */
	if ((buf == NULL) || (buf->len == 0U) || (buf->len > CONFIG_BT_ISO_RX_MTU))
	{
		rx_stats->bad_len++;
	}
}

void rx_stats_prepare_uplink_payload(uint8_t *data, size_t sdu_len, uint16_t seq_num, uint8_t active_uplink_bis)
{
	refresh_report_cache();
	report_cache.seq_num = sys_cpu_to_le16(seq_num);
	report_cache.uplink_bis = active_uplink_bis;
	report_cache.dev_id_len = grptlk_device_id_len;
	memcpy(report_cache.dev_id, grptlk_device_id, sizeof(report_cache.dev_id));
	memcpy(data, &report_cache, MIN(sdu_len, sizeof(report_cache)));
}

#endif /* IS_ENABLED(CONFIG_GRPTLK_ISO_STATS_ENABLED) */
```

## src/rx_stats.h
```c
#ifndef RX_STATS_H
#define RX_STATS_H

#include <zephyr/bluetooth/iso.h>
#include <stddef.h>

struct net_buf;
struct bt_iso_recv_info;
struct bt_iso_chan;

#if IS_ENABLED(CONFIG_GRPTLK_ISO_STATS_ENABLED)

void rx_stats_init_device_id(void);
void rx_stats_init_report_cache(uint8_t active_uplink_bis);
void rx_stats_reset_seq(void);

void rx_stats_tx_ok(void);
void rx_stats_tx_alloc_fail(void);
void rx_stats_tx_send_fail(void);

void rx_stats_rx_downlink(const struct bt_iso_recv_info *info, struct net_buf *buf);

void rx_stats_prepare_uplink_payload(uint8_t *data, size_t sdu_len, uint16_t seq_num, uint8_t active_uplink_bis);

void rx_stats_set_phy(uint8_t phy);
void rx_stats_update_chan_info(struct bt_iso_chan *chan);

#else

static inline void rx_stats_init_device_id(void) {}
static inline void rx_stats_init_report_cache(uint8_t active_uplink_bis) {}
static inline void rx_stats_reset_seq(void) {}

static inline void rx_stats_tx_ok(void) {}
static inline void rx_stats_tx_alloc_fail(void) {}
static inline void rx_stats_tx_send_fail(void) {}

static inline void rx_stats_rx_downlink(const struct bt_iso_recv_info *info, struct net_buf *buf) {}

static inline void rx_stats_prepare_uplink_payload(uint8_t *data, size_t sdu_len, uint16_t seq_num, uint8_t active_uplink_bis)
{
	if (data && sdu_len > 0) {
		memset(data, (uint8_t)seq_num, sdu_len);
	}
}

static inline void rx_stats_set_phy(uint8_t phy) { (void)phy; }
static inline void rx_stats_update_chan_info(struct bt_iso_chan *chan) { (void)chan; }

#endif /* IS_ENABLED(CONFIG_GRPTLK_ISO_STATS_ENABLED) */

#endif /* RX_STATS_H */
```
