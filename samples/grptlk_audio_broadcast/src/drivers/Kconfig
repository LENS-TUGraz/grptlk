## samples/grptlk_audio_broadcast/src/drivers/Kconfig
```kconfig
module = MAX9867
module-str = max9867
source "subsys/logging/Kconfig.template.log_config"
```

## samples/grptlk_audio_receive/src/io/Kconfig
```kconfig
module = BUTTON
module-str = button
source "subsys/logging/Kconfig.template.log_config"

module = QDEC
module-str = qdec
source "subsys/logging/Kconfig.template.log_config"
```

## samples/peripheral_hr/boards/hwn001_nrf54l15_cpuapp.conf
```kconfig
#  Advertisement and Scan Data Lengths
CONFIG_BT_CTLR_ADV_DATA_LEN_MAX=191
CONFIG_BT_CTLR_SCAN_DATA_LEN_MAX=1650
```

## west.yml
```yaml
manifest:
  version: 1.2

  self:
    path: grptlk

  remotes:
    - name: lens
      url-base: git@github.com:LENS-TUGraz

  projects:
    - name: sdk-nrf
      path: nrf
      remote: lens
      revision: v3.1.0-grptlk
      import: true
```
