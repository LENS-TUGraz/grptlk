## CMakeLists.txt
```
# SPDX-License-Identifier: Apache-2.0

cmake_minimum_required(VERSION 3.20.0)
find_package(Zephyr REQUIRED HINTS $ENV{ZEPHYR_BASE})
project(iso_broadcast)

target_include_directories(app PRIVATE ${CMAKE_CURRENT_SOURCE_DIR}/../common/include)
target_sources(app PRIVATE src/main.c)
target_sources(app PRIVATE src/uplink_stats.c)
```

## Kconfig
```
menuconfig GRPTLK
	bool "GRPTLK [EXPERIMENTAL]"
	select EXPERIMENTAL
	default n

if GRPTLK

config GRPTLK_ISO_CHAN_COUNT
	int "Number of BIS channels to create"
	range 2 31
	default 5
	help
	  Number of BIS channels the ISO broadcast sample creates in the BIG.
	  BIS1 is downlink (TX). BIS2..BISn are uplink RX slots from receivers.
	  For nRF53 sysbuild builds, this value is driven by
	  SB_CONFIG_GRPTLK_ISO_CHAN_COUNT from Kconfig.sysbuild.

config GRPTLK_ISO_SDU_INTERVAL_US
	int "BIG SDU interval in microseconds"
	default 10000
	help
	  The SDU interval in microseconds for the Broadcast Isochronous Group (BIG).

config GRPTLK_ISO_STATS
	bool "Enable ISO TX/RX statistics tracking"
	default y
	help
	  Enable tracking and printing of ISO broadcast channel statistics.
	  Includes DL TX success rates and UL RX packet counts/errors
	  received from ISO reporters.

choice GRPTLK_ROLE
    bool "GRPTLK Role"
    default GRPTLK_BCST

config GRPTLK_BCST
    bool "GRPTLK Broadcaster Role"

config GRPTLK_RECV
    bool "GRPTLK Receiver Role"

endchoice

config BT_ISO_MAX_CHAN
	default GRPTLK_ISO_CHAN_COUNT if GRPTLK_BCST

config BT_ISO_TX_BUF_COUNT
	default 8 if GRPTLK_BCST

config BT_ISO_RX_BUF_COUNT
	default 8 if GRPTLK_BCST

config BT_BUF_EVT_RX_COUNT
	default 16 if GRPTLK_BCST

# Single-core controller tuning follows the GRPTLK channel count.
config BT_CTLR_ADV_DATA_LEN_MAX
	default 191 if GRPTLK_BCST && BT_CTLR_ADV_EXT

config BT_CTLR_SCAN_DATA_LEN_MAX
	default 255 if GRPTLK_BCST && BT_CTLR_ADV_EXT

# Broadcaster TX SDU is BT_ISO_TX_MTU (40). PDU = SDU + controller header.
# 48 = 40 (SDU) + 8 (controller overhead).
config BT_CTLR_ADV_ISO_PDU_LEN_MAX
	default 48 if GRPTLK_BCST && BT_CTLR_ADV_ISO

# Broadcaster RX (uplink) SDUs are grptlk_uplink_stats_v2 (40 bytes, same as downlink SDU).
# PDU = SDU + controller overhead (8 bytes) => 48.
config BT_CTLR_SYNC_ISO_PDU_LEN_MAX
	default 48 if GRPTLK_BCST && BT_CTLR_SYNC_ISO && !BT_HCI_RAW

config BT_CTLR_ADV_ISO_STREAM_MAX
	default GRPTLK_ISO_CHAN_COUNT if GRPTLK_BCST && BT_CTLR_ADV_ISO

config BT_CTLR_ADV_ISO_STREAM_COUNT
	default GRPTLK_ISO_CHAN_COUNT if GRPTLK_BCST && BT_CTLR_ADV_ISO

# Broadcaster receives on MAX-1 uplink BISes (BIS2..BISn).
# Use MAX here for simplicity; one extra slot costs negligible memory.
config BT_CTLR_SYNC_ISO_STREAM_MAX
	default GRPTLK_ISO_CHAN_COUNT if GRPTLK_BCST && BT_CTLR_SYNC_ISO

config BT_CTLR_SYNC_ISO_STREAM_COUNT
	default GRPTLK_ISO_CHAN_COUNT if GRPTLK_BCST && BT_CTLR_SYNC_ISO

config BT_CTLR_ISOAL_SOURCES
	default GRPTLK_ISO_CHAN_COUNT if GRPTLK_BCST && (BT_CTLR_ADV_ISO || BT_CTLR_CONN_ISO)

config BT_CTLR_ISOAL_SINKS
	default GRPTLK_ISO_CHAN_COUNT if GRPTLK_BCST && (BT_CTLR_SYNC_ISO || BT_CTLR_CONN_ISO)

config BT_CTLR_ISO_TX_BUFFERS
	default BT_ISO_TX_BUF_COUNT if GRPTLK_BCST && (BT_CTLR_ADV_ISO || BT_CTLR_CONN_ISO)

config BT_CTLR_ISO_RX_BUFFERS
	default 8 if GRPTLK_BCST && (BT_CTLR_SYNC_ISO || BT_CTLR_CONN_ISO)

config BT_CTLR_ISO_TX_BUFFER_SIZE
	default 48 if GRPTLK_BCST && (BT_CTLR_ADV_ISO || BT_CTLR_CONN_ISO)

config BT_CTLR_ISO_TX_SDU_LEN_MAX
	default 40 if GRPTLK_BCST && (BT_CTLR_ADV_ISO || BT_CTLR_CONN_ISO)

endif # GRPTLK

source "Kconfig.zephyr"
```

## Kconfig.sysbuild
```
# Copyright 2023 Nordic Semiconductor ASA
# SPDX-License-Identifier: Apache-2.0

source "share/sysbuild/Kconfig"

config GRPTLK_ISO_CHAN_COUNT
	int "Number of BIS channels to create"
	range 2 31
	default 4
	help
	  Number of BIS channels the ISO broadcast sample creates in the BIG.
	  BIS1 is downlink (TX). BIS2..BISn are uplink RX slots from receivers.
	  Change this symbol for nRF53 builds to adjust the BIG size.

config NET_CORE_BOARD
	string
	default "nrf5340dk/nrf5340/cpunet" if "$(BOARD)" = "nrf5340dk"
	default "nrf5340_audio_dk/nrf5340/cpunet" if "$(BOARD)" = "nrf5340_audio_dk"
	default "nrf5340bsim/nrf5340/cpunet" if $(BOARD_TARGET_STRING) = "NRF5340BSIM_NRF5340_CPUAPP"

config NET_CORE_IMAGE_HCI_IPC
	bool "HCI IPC image on network core"
	default y
	depends on NET_CORE_BOARD != ""
```

## prj.conf
```kconfig
# GRPTLK
CONFIG_GRPTLK=y
CONFIG_GRPTLK_BCST=y

# GRPTLK Payload: <counter><bis_id><src_id>
#   counter: 4 bytes
#   src_id : 1 byte
#   bis_id : 1 byte
# Total: 6 bytes
CONFIG_BT_ISO_TX_MTU=40

# Uplink RX: receivers send grptlk_uplink_stats_v2 (40 bytes, same as downlink SDU)
CONFIG_BT_ISO_RX_MTU=40

# System
CONFIG_SYSTEM_WORKQUEUE_STACK_SIZE=2048

# Bluetooth
CONFIG_BT=y
CONFIG_BT_OBSERVER=y
CONFIG_BT_BROADCASTER=y
CONFIG_BT_DEVICE_NAME="GRPTLK Broadcaster"

# Host features
CONFIG_BT_HCI=y
CONFIG_BT_HCI_VS=y

# ISO features
CONFIG_BT_ISO_BROADCASTER=y
CONFIG_BT_ISO_SYNC_RECEIVER=y

# Logging
CONFIG_LOG=y
CONFIG_BT_ISO_LOG_LEVEL_DBG=y
# CONFIG_LOG_MODE_IMMEDIATE=y
CONFIG_LOG_BUFFER_SIZE=4024

# Set same the ACL RX buffer size as in hci_ipc on netcore so that
# HCI Controller to Host Flowcontrol is supported.
CONFIG_BT_BUF_ACL_RX_SIZE=255

# Add Ozone debugger support
CONFIG_DEBUG_THREAD_INFO=y
CONFIG_HEAP_MEM_POOL_SIZE=256
```

## netcore.conf
```kconfig
# Overlay on:
# zephyr/samples/bluetooth/hci_ipc/nrf5340_cpunet_iso-bt_ll_sw_split.conf
#
# Goal for GroupTalk netcore (broadcaster role):
# - support both GroupTalk roles (broadcaster + uplink receiver)
# - keep only BIS broadcast/sync roles (no connected ISO roles)
# - free controller memory headroom for higher ISO stream counts

# Enable GRPTLK also in the netcore
CONFIG_GRPTLK=y

# Keep both BIS directions available for broadcaster + uplink RX use.
CONFIG_BT_BROADCASTER=y
CONFIG_BT_OBSERVER=y
CONFIG_BT_EXT_ADV=y
CONFIG_BT_PER_ADV=y
CONFIG_BT_ISO_BROADCASTER=y
CONFIG_BT_ISO_SYNC_RECEIVER=y

# Only keep roles/features required by GroupTalk BIS traffic in both roles.
CONFIG_BT_CENTRAL=n
CONFIG_BT_PERIPHERAL=n
CONFIG_BT_ISO_CENTRAL=n
CONFIG_BT_ISO_PERIPHERAL=n
CONFIG_BT_CTLR_CENTRAL_ISO=n
CONFIG_BT_CTLR_PERIPHERAL_ISO=n
CONFIG_BT_PER_ADV_SYNC_TRANSFER_SENDER=n
CONFIG_BT_PER_ADV_SYNC_TRANSFER_RECEIVER=n
CONFIG_BT_CTLR_SYNC_TRANSFER_SENDER=n
CONFIG_BT_CTLR_SYNC_TRANSFER_RECEIVER=n
CONFIG_BT_CTLR_DTM_HCI=n
# PHY capability:
# - 1M PHY is mandatory in LE controller (always available)
# - keep both optional PHYs enabled for GroupTalk flexibility
CONFIG_BT_CTLR_PHY_2M=y
CONFIG_BT_CTLR_PHY_CODED=y
CONFIG_BT_CTLR_TX_PWR_DYNAMIC_CONTROL=n
CONFIG_BT_CTLR_ADVANCED_FEATURES=n
CONFIG_BT_CTLR_ADV_SET=1
CONFIG_BT_CTLR_ADV_AUX_SET=1
CONFIG_BT_CTLR_ADV_SYNC_SET=1
CONFIG_BT_CTLR_SCAN_AUX_SET=1
CONFIG_BT_CTLR_ADV_DATA_BUF_MAX=2

# Advertisement and Scan Data Lengths
CONFIG_BT_CTLR_ADV_DATA_LEN_MAX=191
CONFIG_BT_CTLR_SCAN_DATA_LEN_MAX=255

# ISO Settings
CONFIG_BT_CTLR_ADV_ISO=y
CONFIG_BT_CTLR_ADV_ISO_INTERLEAVED=n
# Keep headroom for future SDU size growth without a netcore rebuild.
CONFIG_BT_CTLR_ADV_ISO_PDU_LEN_MAX=247

CONFIG_BT_CTLR_SYNC_ISO=y
CONFIG_BT_CTLR_SYNC_ISO_INTERLEAVED=n
# NOTE:
# With hci_ipc (BT_HCI_RAW), Zephyr constrains this to 251, so this cannot
# currently be reduced below 251 even if runtime payloads are smaller.
CONFIG_BT_CTLR_SYNC_ISO_PDU_LEN_MAX=251

# NOTE:
# Fallback stream/channel limits for shared netcore.conf use.
# In nRF53 iso_broadcast sysbuild builds, these values are overridden from
# SB_CONFIG_GRPTLK_MAX_ISO_CHAN_COUNT in samples/iso_broadcast/sysbuild.cmake.
CONFIG_BT_CTLR_ADV_ISO_STREAM_MAX=5
CONFIG_BT_CTLR_ADV_ISO_STREAM_COUNT=5
# Broadcaster receives on MAX-1 uplink BISes (BIS2..BISn).
CONFIG_BT_CTLR_SYNC_ISO_STREAM_MAX=4
CONFIG_BT_CTLR_SYNC_ISO_STREAM_COUNT=4
CONFIG_BT_CTLR_ISOAL_SOURCES=5
CONFIG_BT_CTLR_ISOAL_SINKS=4
CONFIG_BT_ISO_MAX_CHAN=5

# 40-byte SDU + max 8-byte HCI ISO data header overhead
CONFIG_BT_CTLR_ISO_TX_BUFFER_SIZE=48
CONFIG_BT_CTLR_ISO_TX_SDU_LEN_MAX=40

# Keep default hci_ipc heap and tune ISO HCI raw buffer footprint.
CONFIG_HEAP_MEM_POOL_SIZE=4096
# Runtime payload length matches configured TX MTU.
CONFIG_BT_ISO_TX_MTU=40
CONFIG_BT_ISO_RX_MTU=40
CONFIG_BT_ISO_TX_BUF_COUNT=8
CONFIG_BT_ISO_RX_BUF_COUNT=8
CONFIG_BT_BUF_EVT_RX_COUNT=16

# Controller queueing tuned for continuous GroupTalk ISO traffic.
CONFIG_BT_CTLR_RX_BUFFERS=9
CONFIG_BT_CTLR_ISO_TX_BUFFERS=8
CONFIG_BT_CTLR_ISO_RX_BUFFERS=8
```

## boards/hwn001_nrf54l15_cpuapp.conf
```kconfig
# Single-core controller tuning is centralized in samples/iso_broadcast/Kconfig.
CONFIG_BT_CTLR_ADV_ISO=y
CONFIG_BT_CTLR_SYNC_ISO=y
```

## src/main.c
```c
#include "uplink_stats.h"
#include <string.h>
#include <zephyr/bluetooth/bluetooth.h>
#include <zephyr/bluetooth/iso.h>
#include <zephyr/kernel.h>
#include <zephyr/logging/log.h>
#include <zephyr/sys/byteorder.h>
#include <zephyr/sys/util.h>

#define BIG_SDU_INTERVAL_US CONFIG_GRPTLK_ISO_SDU_INTERVAL_US
#define BUF_ALLOC_TIMEOUT_US (BIG_SDU_INTERVAL_US * 2U)

/* BIS count follows the sysbuild knob (default 2). */
#define BIS_ISO_CHAN_COUNT CONFIG_GRPTLK_ISO_CHAN_COUNT
#define NUM_PRIME_PACKETS 2

LOG_MODULE_REGISTER(grptlk_iso_broadcast);

NET_BUF_POOL_FIXED_DEFINE(bis_tx_pool, BIS_ISO_CHAN_COUNT *NUM_PRIME_PACKETS,
                          BT_ISO_SDU_BUF_SIZE(CONFIG_BT_ISO_TX_MTU),
                          CONFIG_BT_CONN_TX_USER_DATA_SIZE, NULL);

static K_SEM_DEFINE(sem_big_cmplt, 0, BIS_ISO_CHAN_COUNT);
static K_SEM_DEFINE(sem_big_term, 0, BIS_ISO_CHAN_COUNT);

static struct bt_iso_chan *bis[BIS_ISO_CHAN_COUNT];

static uint16_t seq_num;
static uint8_t iso_data[CONFIG_BT_ISO_TX_MTU] = {0};

static int iso_chan_index(struct bt_iso_chan *chan) {
  for (int i = 0; i < BIS_ISO_CHAN_COUNT; i++) {
    if (chan == bis[i]) {
      return i;
    }
  }

  return -1;
}

#define TX_THREAD_STACK_SIZE 1024
#define TX_THREAD_PRIORITY 5

K_THREAD_STACK_DEFINE(tx_thread_stack, TX_THREAD_STACK_SIZE);
static struct k_thread tx_thread_data;
static K_SEM_DEFINE(tx_sem, NUM_PRIME_PACKETS, NUM_PRIME_PACKETS);

static void iso_connected(struct bt_iso_chan *chan) {
  LOG_INF("ISO Channel %p connected", chan);
  seq_num = 0U;
  iso_stats_reset_seq();
  k_sem_give(&sem_big_cmplt);
}

static void iso_disconnected(struct bt_iso_chan *chan, uint8_t reason) {
  LOG_INF("ISO Channel %p disconnected with reason 0x%02x", chan, reason);
  k_sem_give(&sem_big_term);
}

static void tx_thread(void *arg1, void *arg2, void *arg3) {
  int err;
  struct net_buf *buf;

  while (true) {
    k_sem_take(&tx_sem, K_FOREVER);

    buf = net_buf_alloc(&bis_tx_pool, K_NO_WAIT);
    if (!buf) {
      iso_stats_tx_alloc_fail();
      continue;
    }

    net_buf_reserve(buf, BT_ISO_CHAN_SEND_RESERVE);

    memset(iso_data, 1, sizeof(iso_data));
    net_buf_add_mem(buf, iso_data, sizeof(iso_data));

    err = bt_iso_chan_send(bis[0], buf, seq_num);
    if (err < 0) {
      iso_stats_tx_send_fail();
      net_buf_unref(buf);
      continue;
    }

    iso_stats_tx_ok();
    seq_num++;
  }
}

static void iso_sent(struct bt_iso_chan *chan) {
  if (chan == bis[0]) {
    k_sem_give(&tx_sem);
  }
}

static void iso_recv(struct bt_iso_chan *chan,
                     const struct bt_iso_recv_info *info, struct net_buf *buf) {
  int chan_idx;

  chan_idx = iso_chan_index(chan);
  if (chan_idx < 0) {
    iso_stats_rx_unknown_chan();
    return;
  }

  /* Broadcaster should only RX uplink on BIS2..BIS5. */
  if (chan_idx == 0) {
    iso_stats_rx_unexpected_bis1();
    return;
  }

  iso_stats_rx(chan_idx, info, buf);
}

static struct bt_iso_chan_ops iso_ops = {
    .connected = iso_connected,
    .disconnected = iso_disconnected,
    .sent = iso_sent,
    .recv = iso_recv,
};

static struct bt_iso_chan_io_qos iso_rx_qos;
static struct bt_iso_chan_io_qos iso_tx_qos = {
    .sdu = CONFIG_BT_ISO_TX_MTU,
    .rtn = 2,
    .phy = BT_GAP_LE_PHY_2M,
};

static struct bt_iso_chan_qos bis_iso_qos = {
    .tx = &iso_tx_qos,
    .rx = &iso_rx_qos,
};

static struct bt_iso_chan bis_iso_chan[BIS_ISO_CHAN_COUNT];

static void iso_init_channels(void) {
  for (int i = 0; i < BIS_ISO_CHAN_COUNT; i++) {
    bis_iso_chan[i].ops = &iso_ops;
    bis_iso_chan[i].qos = &bis_iso_qos;
    bis[i] = &bis_iso_chan[i];
  }
}

static struct bt_iso_big_create_param big_create_param = {
    .num_bis = BIS_ISO_CHAN_COUNT,
    .bis_channels = bis,
    .interval = BIG_SDU_INTERVAL_US,
    .latency = 10,
    .packing = BT_ISO_PACKING_SEQUENTIAL,
    .framing = BT_ISO_FRAMING_UNFRAMED,
};

static const struct bt_data ad[] = {
    BT_DATA(BT_DATA_NAME_COMPLETE, CONFIG_BT_DEVICE_NAME,
            sizeof(CONFIG_BT_DEVICE_NAME) - 1),
};

int main(void) {
  struct bt_le_ext_adv *adv;
  struct bt_iso_big *big;
  int err;

  iso_init_channels();
  LOG_INF("Starting GRPTLK Broadcaster");
  iso_log_startup_hint();
  iso_start_stats_thread(bis, BIS_ISO_CHAN_COUNT);

  err = bt_enable(NULL);
  if (err) {
    LOG_ERR("Bluetooth init failed (err %d)", err);
    return 0;
  }

  err = bt_le_ext_adv_create(BT_LE_EXT_ADV_NCONN, NULL, &adv);
  if (err) {
    LOG_ERR("Failed to create advertising set (err %d)", err);
    return 0;
  }

  err = bt_le_ext_adv_set_data(adv, ad, ARRAY_SIZE(ad), NULL, 0);
  if (err) {
    LOG_ERR("Failed to set advertising data (err %d)", err);
    return 0;
  }

  err = bt_le_per_adv_set_param(adv, BT_LE_PER_ADV_DEFAULT);
  if (err) {
    LOG_ERR("Failed to set periodic advertising parameters (err %d)", err);
    return 0;
  }

  err = bt_le_per_adv_start(adv);
  if (err) {
    LOG_ERR("Failed to enable periodic advertising (err %d)", err);
    return 0;
  }

  err = bt_le_ext_adv_start(adv, BT_LE_EXT_ADV_START_DEFAULT);
  if (err) {
    LOG_ERR("Failed to start extended advertising (err %d)", err);
    return 0;
  }

  err = bt_iso_big_create(adv, &big_create_param, &big);
  if (err) {
    LOG_ERR("Failed to create BIG (err %d)", err);
    return 0;
  }

  for (uint8_t chan = 0U; chan < BIS_ISO_CHAN_COUNT; chan++) {
    LOG_INF("Waiting for BIG complete chan %u...", chan);

    err = k_sem_take(&sem_big_cmplt, K_FOREVER);
    if (err) {
      LOG_ERR("failed (err %d)", err);
      return 0;
    }

    LOG_INF("BIG create complete chan %u.", chan);
  }

  for (uint8_t chan = 0U; chan < BIS_ISO_CHAN_COUNT; chan++) {
    LOG_INF("Setting data path chan %u...", chan);

    const struct bt_iso_chan_path hci_path = {
        .pid = BT_ISO_DATA_PATH_HCI,
        .format = BT_HCI_CODING_FORMAT_TRANSPARENT,
    };

    uint8_t dir = BT_HCI_DATAPATH_DIR_CTLR_TO_HOST;

    if (chan == 0) {
      dir = BT_HCI_DATAPATH_DIR_HOST_TO_CTLR;
    }

    err = bt_iso_setup_data_path(&bis_iso_chan[chan], dir, &hci_path);
    if (err != 0) {
      LOG_ERR("Failed to setup ISO data path: %d", err);
    }

    LOG_INF("Setting data path complete chan %u.", chan);
  }

  k_thread_create(&tx_thread_data, tx_thread_stack,
                  K_THREAD_STACK_SIZEOF(tx_thread_stack), tx_thread, NULL, NULL,
                  NULL, TX_THREAD_PRIORITY, 0, K_NO_WAIT);

  for (int i = 0; i < NUM_PRIME_PACKETS; i++) {
    k_sem_give(&tx_sem);
  }
}
```

## src/uplink_stats.c
```c
#include "uplink_stats.h"

#if IS_ENABLED(CONFIG_GRPTLK_ISO_STATS)

#include <zephyr/bluetooth/bluetooth.h>
#include <zephyr/bluetooth/iso.h>
#include <zephyr/kernel.h>
#include <zephyr/logging/log.h>
#include <zephyr/sys/byteorder.h>
#include <string.h>
#include <grptlk_uplink_stats.h>

#define BIS_ISO_CHAN_COUNT           CONFIG_GRPTLK_ISO_CHAN_COUNT
#define ISO_STATS_PRINT_INTERVAL_MS  10U
#define CHAN_INFO_TICK_PERIOD        10U
#define UPLINK_REPORTER_STALE_MS    5000U
#define MAX_UPLINK_REPORTERS        (BIS_ISO_CHAN_COUNT * 4U)

LOG_MODULE_DECLARE(grptlk_iso_broadcast);

struct iso_tx_stats
{
	uint32_t ok;
	uint32_t alloc_fail;
	uint32_t send_fail;
};

struct iso_rx_stats
{
	uint32_t total;
	uint32_t valid_flag;
	uint32_t lost_flag;
	uint32_t error_flag;
	uint32_t bad_len;
	uint32_t seq_gap_events;
	uint32_t seq_gap_packets;
	uint32_t old_or_dup;
};

struct uplink_reporter_state
{
	bool used;
	uint8_t transport_bis;
	uint8_t uplink_bis;
	uint8_t dev_id_len;
	uint8_t dev_id[GRPTLK_DEVICE_ID_LEN];
	uint16_t seq_num;
	uint16_t interval_ms;
	uint16_t dl_rx_total;
	uint16_t dl_rx_valid;
	uint16_t dl_rx_lost;
	uint16_t dl_rx_gap_packets;
	uint16_t dl_rx_gap_events;
	uint16_t dl_rx_old_or_dup;
	uint16_t ul_tx_ok;
	uint16_t ul_tx_alloc_fail;
	uint16_t ul_tx_send_fail;
	uint16_t chan_max_pdu;
	uint8_t  chan_bn;
	uint8_t  chan_irc;
	uint8_t  phy;
	uint32_t last_seen_ms;
	uint16_t prev_seq_num;
	bool seq_initialized;
	uint32_t ul_lost_payload;
	uint16_t prev_dl_rx_total;
	uint16_t prev_dl_rx_valid;
	uint16_t prev_dl_rx_lost;
	uint16_t prev_dl_rx_gap_packets;
	uint16_t prev_dl_rx_old_or_dup;
	bool dl_delta_initialized;
};

static struct iso_tx_stats iso_downlink_tx_stats;
static struct iso_rx_stats iso_uplink_rx_stats[BIS_ISO_CHAN_COUNT];
static uint32_t iso_recv_unexpected_bis1_count;
static uint32_t iso_recv_unknown_chan_count;
static uint32_t iso_recv_chan_count[BIS_ISO_CHAN_COUNT];
static uint16_t iso_recv_expected_seq[BIS_ISO_CHAN_COUNT];
static bool iso_recv_seq_initialized[BIS_ISO_CHAN_COUNT];
static struct uplink_reporter_state uplink_reporters[MAX_UPLINK_REPORTERS];
static uint32_t uplink_report_frames;
static uint32_t uplink_report_short;
static uint32_t uplink_report_parse_fail;
static uint32_t uplink_report_table_full;

static struct iso_tx_stats prev_iso_downlink_tx_stats;
static struct iso_rx_stats prev_iso_uplink_rx_stats[BIS_ISO_CHAN_COUNT];
static uint32_t prev_uplink_report_frames;
static uint32_t prev_uplink_report_short;
static uint32_t prev_uplink_report_parse_fail;
static uint32_t prev_uplink_report_table_full;

static struct bt_iso_chan **stats_bis;
static int stats_bis_count;

static struct iso_rx_stats *iso_rx_stats_for_chan(int chan_idx)
{
	if ((chan_idx > 0) && (chan_idx < BIS_ISO_CHAN_COUNT))
	{
		return &iso_uplink_rx_stats[chan_idx];
	}

	return NULL;
}

static uint32_t stats_delta_u32(uint32_t now, uint32_t *prev)
{
	uint32_t delta = now - *prev;

	*prev = now;
	return delta;
}

static uint8_t clamp_dev_id_len(uint8_t len)
{
	return (len > GRPTLK_DEVICE_ID_LEN) ? GRPTLK_DEVICE_ID_LEN : len;
}

static int find_reporter_slot(const uint8_t *dev_id, uint8_t dev_id_len)
{
	int free_slot = -1;

	for (int i = 0; i < MAX_UPLINK_REPORTERS; i++)
	{
		if (!uplink_reporters[i].used)
		{
			if (free_slot < 0)
			{
				free_slot = i;
			}

			continue;
		}

		if ((uplink_reporters[i].dev_id_len == dev_id_len) &&
		    (memcmp(uplink_reporters[i].dev_id, dev_id, GRPTLK_DEVICE_ID_LEN) == 0))
		{
			return i;
		}
	}

	return free_slot;
}

static void reporter_update(struct uplink_reporter_state *r,
			    int chan_idx, uint16_t rx_seq,
			    uint8_t dev_id_len, const uint8_t *dev_id,
			    uint8_t uplink_bis, uint16_t interval_ms,
			    uint16_t dl_rx_total, uint16_t dl_rx_valid,
			    uint16_t dl_rx_lost, uint16_t dl_rx_gap_packets,
			    uint16_t dl_rx_old_or_dup,
			    uint16_t ul_tx_ok, uint16_t ul_tx_alloc_fail,
			    uint16_t ul_tx_send_fail)
{
	if (r->used && r->seq_initialized) {
		uint16_t delta = (uint16_t)(rx_seq - (r->prev_seq_num + 1U));

		if ((delta > 0U) && (delta < 0x8000U)) {
			r->ul_lost_payload += delta;
		}
	} else {
		r->ul_lost_payload = 0U;
		r->seq_initialized = false;
	}

	if (!r->used || !r->dl_delta_initialized) {
		r->prev_dl_rx_total       = dl_rx_total;
		r->prev_dl_rx_valid       = dl_rx_valid;
		r->prev_dl_rx_lost        = dl_rx_lost;
		r->prev_dl_rx_gap_packets = dl_rx_gap_packets;
		r->prev_dl_rx_old_or_dup  = dl_rx_old_or_dup;
		r->dl_delta_initialized   = true;
	}

	r->used           = true;
	r->prev_seq_num   = rx_seq;
	r->seq_initialized = true;
	r->transport_bis  = (uint8_t)(chan_idx + 1);
	r->uplink_bis     = uplink_bis;
	r->dev_id_len     = dev_id_len;
	memcpy(r->dev_id, dev_id, GRPTLK_DEVICE_ID_LEN);
	r->seq_num        = rx_seq;
	r->interval_ms    = interval_ms;
	r->dl_rx_total    = dl_rx_total;
	r->dl_rx_valid    = dl_rx_valid;
	r->dl_rx_lost     = dl_rx_lost;
	r->dl_rx_gap_packets = dl_rx_gap_packets;
	r->dl_rx_old_or_dup  = dl_rx_old_or_dup;
	r->ul_tx_ok       = ul_tx_ok;
	r->ul_tx_alloc_fail = ul_tx_alloc_fail;
	r->ul_tx_send_fail  = ul_tx_send_fail;
	r->last_seen_ms   = k_uptime_get_32();
	uplink_report_frames++;
}

static bool parse_uplink_report(int chan_idx, struct net_buf *buf)
{
	struct uplink_reporter_state *reporter;
	int slot;
	uint8_t dev_id_len;

	if ((buf == NULL) || (buf->len < sizeof(struct grptlk_uplink_stats_v1)))
	{
		uplink_report_short++;
		return false;
	}

	const uint8_t *raw = buf->data;

	if ((raw[0] != GRPTLK_UPLINK_MAGIC_0) || (raw[1] != GRPTLK_UPLINK_MAGIC_1))
	{
		uplink_report_parse_fail++;
		return false;
	}

	uint8_t version = raw[2];
	uint8_t type    = raw[3];

	if (version == GRPTLK_UPLINK_VERSION &&
	    type == GRPTLK_UPLINK_TYPE_STATS_V1 &&
	    buf->len >= sizeof(struct grptlk_uplink_stats_v1))
	{
		struct grptlk_uplink_stats_v1 frame;

		memcpy(&frame, buf->data, sizeof(frame));
		dev_id_len = clamp_dev_id_len(frame.dev_id_len);
		slot = find_reporter_slot(frame.dev_id, dev_id_len);
		if (slot < 0) {
			uplink_report_table_full++;
			return false;
		}

		reporter = &uplink_reporters[slot];
		reporter_update(reporter, chan_idx,
				sys_le16_to_cpu(frame.seq_num),
				dev_id_len, frame.dev_id,
				frame.uplink_bis,
				sys_le16_to_cpu(frame.interval_ms),
				sys_le16_to_cpu(frame.dl_rx_total),
				sys_le16_to_cpu(frame.dl_rx_valid),
				sys_le16_to_cpu(frame.dl_rx_lost),
				sys_le16_to_cpu(frame.dl_rx_gap_packets),
				sys_le16_to_cpu(frame.dl_rx_old_or_dup),
				sys_le16_to_cpu(frame.ul_tx_ok),
				sys_le16_to_cpu(frame.ul_tx_alloc_fail),
				sys_le16_to_cpu(frame.ul_tx_send_fail));
		reporter->dl_rx_gap_events = 0U;
		reporter->chan_max_pdu = 0U;
		reporter->chan_bn      = 0U;
		reporter->chan_irc     = 0U;
		reporter->phy          = 0U;
		return true;
	}

	if (version == GRPTLK_UPLINK_VERSION_2 &&
	    type == GRPTLK_UPLINK_TYPE_STATS_V2 &&
	    buf->len >= sizeof(struct grptlk_uplink_stats_v2))
	{
		struct grptlk_uplink_stats_v2 frame;

		memcpy(&frame, buf->data, sizeof(frame));
		dev_id_len = clamp_dev_id_len(frame.dev_id_len);
		slot = find_reporter_slot(frame.dev_id, dev_id_len);
		if (slot < 0) {
			uplink_report_table_full++;
			return false;
		}

		reporter = &uplink_reporters[slot];
		reporter_update(reporter, chan_idx,
				sys_le16_to_cpu(frame.seq_num),
				dev_id_len, frame.dev_id,
				frame.uplink_bis,
				sys_le16_to_cpu(frame.interval_ms),
				sys_le16_to_cpu(frame.dl_rx_total),
				sys_le16_to_cpu(frame.dl_rx_valid),
				sys_le16_to_cpu(frame.dl_rx_lost),
				sys_le16_to_cpu(frame.dl_rx_gap_packets),
				sys_le16_to_cpu(frame.dl_rx_old_or_dup),
				sys_le16_to_cpu(frame.ul_tx_ok),
				sys_le16_to_cpu(frame.ul_tx_alloc_fail),
				sys_le16_to_cpu(frame.ul_tx_send_fail));
		reporter->dl_rx_gap_events = sys_le16_to_cpu(frame.dl_rx_gap_events);
		reporter->chan_max_pdu     = sys_le16_to_cpu(frame.chan_max_pdu);
		reporter->chan_bn          = GRPTLK_CHAN_INFO_BN(frame.chan_info);
		reporter->chan_irc         = GRPTLK_CHAN_INFO_IRC(frame.chan_info);
		reporter->phy              = frame.phy;
		return true;
	}

	uplink_report_parse_fail++;
	return false;
}

static void format_dev_id_hex(const struct uplink_reporter_state *reporter,
			      char *out, size_t out_len)
{
	if ((out_len == 0U) || (reporter->dev_id_len == 0U)) {
		if (out_len > 0U) {
			out[0] = '\0';
		}
		return;
	}

	size_t written = bin2hex(reporter->dev_id, reporter->dev_id_len, out, out_len - 1U);

	out[written] = '\0';
}

static void log_uplink_chan_stats(int chan_idx)
{
	struct iso_rx_stats *stats = &iso_uplink_rx_stats[chan_idx];
	struct iso_rx_stats *prev = &prev_iso_uplink_rx_stats[chan_idx];
	uint32_t tot_d     = stats_delta_u32(stats->total,          &prev->total);
	uint32_t valid_d   = stats_delta_u32(stats->valid_flag,     &prev->valid_flag);
	uint32_t lost_d    = stats_delta_u32(stats->lost_flag,      &prev->lost_flag);
	uint32_t err_d     = stats_delta_u32(stats->error_flag,     &prev->error_flag);
	uint32_t bad_len_d = stats_delta_u32(stats->bad_len,        &prev->bad_len);
	uint32_t gap_evt_d = stats_delta_u32(stats->seq_gap_events, &prev->seq_gap_events);
	uint32_t gap_pkt_d = stats_delta_u32(stats->seq_gap_packets,&prev->seq_gap_packets);
	uint32_t dup_d     = stats_delta_u32(stats->old_or_dup,     &prev->old_or_dup);

	LOG_INF("UL RX (BIS%d): tot=%u(+%u) valid=%u(+%u) lost=%u(+%u) err=%u(+%u) "
		"bad_len=%u(+%u) gap_pkt=%u(+%u) gap_evt=%u(+%u) dup=%u(+%u) raw_rx=%u",
		chan_idx + 1,
		stats->total,          tot_d,
		stats->valid_flag,     valid_d,
		stats->lost_flag,      lost_d,
		stats->error_flag,     err_d,
		stats->bad_len,        bad_len_d,
		stats->seq_gap_packets,gap_pkt_d,
		stats->seq_gap_events, gap_evt_d,
		stats->old_or_dup,     dup_d,
		iso_recv_chan_count[chan_idx]);
}

static void log_uplink_reporter_stats(void)
{
	uint32_t now = k_uptime_get_32();
	int active_count = 0;

	for (int i = 0; i < MAX_UPLINK_REPORTERS; i++)
	{
		char dev_id_hex[(GRPTLK_DEVICE_ID_LEN * 2U) + 1U];

		if (!uplink_reporters[i].used)
		{
			continue;
		}

		uint32_t age_ms = now - uplink_reporters[i].last_seen_ms;

		if (age_ms > UPLINK_REPORTER_STALE_MS)
		{
			format_dev_id_hex(&uplink_reporters[i], dev_id_hex, sizeof(dev_id_hex));
			printk(GRPTLK_LOG_DATA_PREFIX "dev=%s status=stale age_ms=%u\n",
			       dev_id_hex[0] ? dev_id_hex : "unknown", age_ms);
			uplink_reporters[i].used = false;
			continue;
		}

		active_count++;
	}

	printk(GRPTLK_LOG_DATA_PREFIX "ts=%u active=%d bis_count=%d\n",
	       now, active_count, BIS_ISO_CHAN_COUNT);

	for (int i = 0; i < MAX_UPLINK_REPORTERS; i++)
	{
		char dev_id_hex[(GRPTLK_DEVICE_ID_LEN * 2U) + 1U];

		if (!uplink_reporters[i].used)
		{
			continue;
		}

		struct uplink_reporter_state *r = &uplink_reporters[i];

		format_dev_id_hex(r, dev_id_hex, sizeof(dev_id_hex));

		uint32_t age_ms    = now - r->last_seen_ms;
		uint32_t missed    = age_ms / ISO_STATS_PRINT_INTERVAL_MS;
		uint16_t dl_tot_d  = (uint16_t)(r->dl_rx_total        - r->prev_dl_rx_total);
		uint16_t dl_val_d  = (uint16_t)(r->dl_rx_valid         - r->prev_dl_rx_valid);
		uint16_t dl_lost_d = (uint16_t)(r->dl_rx_lost          - r->prev_dl_rx_lost);
		uint16_t dl_gap_d  = (uint16_t)(r->dl_rx_gap_packets   - r->prev_dl_rx_gap_packets);
		uint16_t dl_dup_d  = (uint16_t)(r->dl_rx_old_or_dup    - r->prev_dl_rx_old_or_dup);

		r->prev_dl_rx_total       = r->dl_rx_total;
		r->prev_dl_rx_valid       = r->dl_rx_valid;
		r->prev_dl_rx_lost        = r->dl_rx_lost;
		r->prev_dl_rx_gap_packets = r->dl_rx_gap_packets;
		r->prev_dl_rx_old_or_dup  = r->dl_rx_old_or_dup;

		const char *bis_match = (r->transport_bis == r->uplink_bis) ? "match" : "mismatch";

		printk(GRPTLK_LOG_DATA_PREFIX
		       "dev=%s bis_rx=%u uplink_bis=%u bis_claim=%s age_ms=%u missed=%u seq=%u "
		       "dl_rx=%u(+%u) dl_valid=%u(+%u) dl_lost=%u(+%u) "
		       "dl_gap=%u(+%u) dl_gap_evt=%u dl_dup=%u(+%u) "
		       "ul_ok=%u ul_alloc=%u ul_send=%u ul_lost=%u "
		       "phy=%u max_pdu=%u bn=%u irc=%u\n",
		       dev_id_hex[0] ? dev_id_hex : "unknown",
		       r->transport_bis, r->uplink_bis, bis_match, age_ms, missed, r->seq_num,
		       r->dl_rx_total,        dl_tot_d,
		       r->dl_rx_valid,        dl_val_d,
		       r->dl_rx_lost,         dl_lost_d,
		       r->dl_rx_gap_packets,  dl_gap_d,
		       r->dl_rx_gap_events,
		       r->dl_rx_old_or_dup,   dl_dup_d,
		       r->ul_tx_ok, r->ul_tx_alloc_fail, r->ul_tx_send_fail, r->ul_lost_payload,
		       r->phy, r->chan_max_pdu, r->chan_bn, r->chan_irc);
	}
}

static void log_chan_info_snapshot(void)
{
	if ((stats_bis == NULL) || (stats_bis_count <= 0)) {
		return;
	}

	for (int i = 0; i < stats_bis_count; i++) {
		struct bt_iso_info info;

		if (stats_bis[i] == NULL) {
			continue;
		}

		int err = bt_iso_chan_get_info(stats_bis[i], &info);

		if (err != 0) {
			LOG_WRN("bt_iso_chan_get_info BIS%d failed: %d", i + 1, err);
			continue;
		}

		if (i == 0) {
			LOG_INF("BIS%d (DL): iso_interval=%u max_subevent=%u can_send=%d can_recv=%d "
				"sync_delay=%u latency=%u pto=%u max_pdu=%u phy=%u bn=%u irc=%u",
				i + 1,
				info.iso_interval, info.max_subevent,
				(int)info.can_send, (int)info.can_recv,
				info.broadcaster.sync_delay, info.broadcaster.latency,
				info.broadcaster.pto, info.broadcaster.max_pdu,
				info.broadcaster.phy, info.broadcaster.bn, info.broadcaster.irc);
		} else {
			LOG_INF("BIS%d (UL): iso_interval=%u max_subevent=%u can_send=%d can_recv=%d "
				"latency=%u pto=%u max_pdu=%u bn=%u irc=%u",
				i + 1,
				info.iso_interval, info.max_subevent,
				(int)info.can_send, (int)info.can_recv,
				info.sync_receiver.latency, info.sync_receiver.pto,
				info.sync_receiver.max_pdu, info.sync_receiver.bn,
				info.sync_receiver.irc);
		}
	}
}

static void log_iso_stats_snapshot(void)
{
	uint32_t dl_tx_ok_d       = stats_delta_u32(iso_downlink_tx_stats.ok,
						     &prev_iso_downlink_tx_stats.ok);
	uint32_t dl_tx_alloc_d    = stats_delta_u32(iso_downlink_tx_stats.alloc_fail,
						     &prev_iso_downlink_tx_stats.alloc_fail);
	uint32_t dl_tx_send_d     = stats_delta_u32(iso_downlink_tx_stats.send_fail,
						     &prev_iso_downlink_tx_stats.send_fail);
	uint32_t frames_d         = stats_delta_u32(uplink_report_frames,     &prev_uplink_report_frames);
	uint32_t short_d          = stats_delta_u32(uplink_report_short,      &prev_uplink_report_short);
	uint32_t parse_fail_d     = stats_delta_u32(uplink_report_parse_fail, &prev_uplink_report_parse_fail);
	uint32_t table_full_d     = stats_delta_u32(uplink_report_table_full, &prev_uplink_report_table_full);

	LOG_INF("----- ISO_BROADCAST STATS [%ums] -----", ISO_STATS_PRINT_INTERVAL_MS);
	LOG_INF("DL TX (BIS1): ok=%u(+%u) alloc_fail=%u(+%u) send_fail=%u(+%u)",
		iso_downlink_tx_stats.ok, dl_tx_ok_d,
		iso_downlink_tx_stats.alloc_fail, dl_tx_alloc_d,
		iso_downlink_tx_stats.send_fail, dl_tx_send_d);

	for (int chan_idx = 1; chan_idx < BIS_ISO_CHAN_COUNT; chan_idx++)
	{
		log_uplink_chan_stats(chan_idx);
	}

	LOG_INF("UL RX anomalies: unknown_chan=%u unexpected_bis1=%u",
		iso_recv_unknown_chan_count, iso_recv_unexpected_bis1_count);
	LOG_INF("UL reports: frames=%u(+%u) short=%u(+%u) parse_fail=%u(+%u) table_full=%u(+%u)",
		uplink_report_frames, frames_d, uplink_report_short, short_d,
		uplink_report_parse_fail, parse_fail_d, uplink_report_table_full, table_full_d);
	log_uplink_reporter_stats();
}

#define ISO_STATS_THREAD_STACK_SIZE 1536
#define ISO_STATS_THREAD_PRIORITY 7
K_THREAD_STACK_DEFINE(iso_stats_thread_stack, ISO_STATS_THREAD_STACK_SIZE);
static struct k_thread iso_stats_thread_data;

static void iso_stats_thread(void *arg1, void *arg2, void *arg3)
{
	ARG_UNUSED(arg1);
	ARG_UNUSED(arg2);
	ARG_UNUSED(arg3);

	uint32_t tick = 0U;

	while (true)
	{
		k_sleep(K_MSEC(ISO_STATS_PRINT_INTERVAL_MS));
		log_iso_stats_snapshot();

		tick++;
		if (tick >= CHAN_INFO_TICK_PERIOD) {
			tick = 0U;
			log_chan_info_snapshot();
		}
	}
}

void iso_log_startup_hint(void)
{
	LOG_INF("ISO stats enabled (period=%u ms, chan-info every %u ms)",
		ISO_STATS_PRINT_INTERVAL_MS,
		ISO_STATS_PRINT_INTERVAL_MS * CHAN_INFO_TICK_PERIOD);
}

void iso_start_stats_thread(struct bt_iso_chan **bis, int count)
{
	stats_bis = bis;
	stats_bis_count = count;

	k_tid_t tid = k_thread_create(&iso_stats_thread_data, iso_stats_thread_stack,
				      K_THREAD_STACK_SIZEOF(iso_stats_thread_stack),
				      iso_stats_thread, NULL, NULL, NULL,
				      ISO_STATS_THREAD_PRIORITY, 0, K_NO_WAIT);

	k_thread_name_set(tid, "iso_stats");
}

void iso_stats_reset_seq(void)
{
	memset(iso_recv_seq_initialized, 0, sizeof(iso_recv_seq_initialized));
}

void iso_stats_tx_ok(void)
{
	iso_downlink_tx_stats.ok++;
}

void iso_stats_tx_alloc_fail(void)
{
	iso_downlink_tx_stats.alloc_fail++;
}

void iso_stats_tx_send_fail(void)
{
	iso_downlink_tx_stats.send_fail++;
}

void iso_stats_rx_unknown_chan(void)
{
	iso_recv_unknown_chan_count++;
}

void iso_stats_rx_unexpected_bis1(void)
{
	iso_recv_unexpected_bis1_count++;
}

void iso_stats_rx(int chan_idx, const struct bt_iso_recv_info *info, struct net_buf *buf)
{
	struct iso_rx_stats *rx_stats;

	iso_recv_chan_count[chan_idx]++;
	rx_stats = iso_rx_stats_for_chan(chan_idx);
	if (!rx_stats) {
		return;
	}

	if (iso_recv_seq_initialized[chan_idx])
	{
		uint16_t delta =
			(uint16_t)(info->seq_num - iso_recv_expected_seq[chan_idx]);

		if ((delta > 0U) && (delta < 0x8000U))
		{
			rx_stats->seq_gap_events++;
			rx_stats->seq_gap_packets += delta;
			/*
			 * In GRPTLK runs the controller path may not always emit BT_ISO_FLAGS_LOST
			 * events for every missed SDU. Reflect observed sequence gaps as lost
			 * packets so UL RX "lost" tracks effective over-the-air loss.
			 */
			rx_stats->lost_flag += delta;
		}
		else if (delta >= 0x8000U)
		{
			rx_stats->old_or_dup++;
		}
	}

	iso_recv_expected_seq[chan_idx] = (uint16_t)(info->seq_num + 1U);
	iso_recv_seq_initialized[chan_idx] = true;
	rx_stats->total++;

	if ((info->flags & BT_ISO_FLAGS_VALID) != 0U)
	{
		rx_stats->valid_flag++;
	}
	if ((info->flags & BT_ISO_FLAGS_LOST) != 0U)
	{
		rx_stats->lost_flag++;
	}
	if ((info->flags & BT_ISO_FLAGS_ERROR) != 0U)
	{
		rx_stats->error_flag++;
	}

	if ((buf == NULL) || (buf->len == 0U) || (buf->len > CONFIG_BT_ISO_TX_MTU))
	{
		rx_stats->bad_len++;
		return;
	}

	(void)parse_uplink_report(chan_idx, buf);
}

#endif /* IS_ENABLED(CONFIG_GRPTLK_ISO_STATS) */
```

## src/uplink_stats.h
```c
#ifndef UPLINK_STATS_H
#define UPLINK_STATS_H

#include <zephyr/bluetooth/iso.h>

struct net_buf;
struct bt_iso_recv_info;
struct bt_iso_chan;

#if IS_ENABLED(CONFIG_GRPTLK_ISO_STATS)

void iso_log_startup_hint(void);
/*
 * Start the stats thread.  bis[] and count are stored so the thread can call
 * bt_iso_chan_get_info() on each channel once per second.
 */
void iso_start_stats_thread(struct bt_iso_chan **bis, int count);
void iso_stats_reset_seq(void);

void iso_stats_tx_ok(void);
void iso_stats_tx_alloc_fail(void);
void iso_stats_tx_send_fail(void);

void iso_stats_rx_unknown_chan(void);
void iso_stats_rx_unexpected_bis1(void);
void iso_stats_rx(int chan_idx, const struct bt_iso_recv_info *info, struct net_buf *buf);

#else

static inline void iso_log_startup_hint(void) {}
static inline void iso_start_stats_thread(struct bt_iso_chan **bis, int count)
{
	(void)bis;
	(void)count;
}
static inline void iso_stats_reset_seq(void) {}

static inline void iso_stats_tx_ok(void) {}
static inline void iso_stats_tx_alloc_fail(void) {}
static inline void iso_stats_tx_send_fail(void) {}

static inline void iso_stats_rx_unknown_chan(void) {}
static inline void iso_stats_rx_unexpected_bis1(void) {}
static inline void iso_stats_rx(int chan_idx, const struct bt_iso_recv_info *info, struct net_buf *buf) {}

#endif /* IS_ENABLED(CONFIG_GRPTLK_ISO_STATS) */

#endif /* UPLINK_STATS_H */
```
